## config/boards/arm/uni60/Kconfig.board
```kconfig
# Zaphod board configuration

# Copyright (c) 2020 Pete Johanson
# SPDX-License-Identifier: MIT

config BOARD_UNI60
	bool "Uni60"
	depends on SOC_NRF52840_QIAA
```

## config/boards/arm/uni60/Kconfig.defconfig
```kconfig
# Copyright (c) 2020 Pete Johanson
# SPDX-License-Identifier: MIT

if BOARD_UNI60

config BOARD
	default "uni60"

config ZMK_KEYBOARD_NAME
	default "MS_Unikorn 60"

if USB_DEVICE_STACK

config USB_NRFX
    default y

endif # USB_DEVICE_STACK

config BT_CTLR
    default BT

config ZMK_BLE
    default y

config ZMK_USB
    default y

endif # BOARD_UNI60
```
